## conf/distro/common.inc
```bitbake
DISTRO_VERSION ??= "UNASSIGNED"
DISTRO_VERSION_mx6s = "i.MX6S"
DISTRO_VERSION_mx6dl = "i.MX6DL"
DISTRO_VERSION_mx6q = "i.MX6Q"
DISTRO_VERSION_mx6ul = "i.MX6UL"
DISTRO_VERSION_ti33x = "AM335x"
DISTRO_VERSION_dm3730 = "DM3730"

VENDOR = "isee"
TARGET_VENDOR = "-${VENDOR}"

FIRMWARE_VERSION= "v1.0"

# Some default locales
IMAGE_LINGUAS ?= "de-de fr-fr en-us es-es"

# Activate config checker
INHERIT += "sanity"

# Accept Freescale License
ACCEPT_FSL_EULA = "1" 

LICENSE_FLAGS_WHITELIST="commercial"
```

## conf/distro/criticallink-qt5.conf
```bitbake
require conf/distro/poky.conf
require common.inc

DISTRO = "criticallink-qt5"
DISTRO_NAME = "ISEE-Release - Critical Link Qt5"

# Remove conflicting backends.
DISTRO_FEATURES_remove = "x11 wayland"

# Pulseaudio for gstreamaer and Qt5
DISTRO_FEATURES_append = "pulseaudio"
```

## conf/distro/isee-release-no-x11.conf
```bitbake
require conf/distro/poky.conf
require common.inc

DISTRO = "isee-release-no-x11"
DISTRO_NAME = "++ IGEP FIRMWARE ${FIRMWARE_VERSION} ++\n\rYocto: ${SDK_VERSION}-${METADATA_BRANCH}\n\rDistro: isee-release-no-x11 \n\rBoard:"

DISTRO_FEATURES_remove = "x11 wayland"
DISTRO_FEAUTRES_append = " pulseaudio"
```

## conf/distro/isee-release.conf
```bitbake
require conf/distro/poky.conf
require common.inc

DISTRO = "isee-release"
DISTRO_NAME = "ISEE-Release"
```

## conf/distro/isee-systemd-no-x11.conf
```bitbake
require conf/distro/poky.conf
require common.inc

DISTRO = "isee-systemd-no-x11"
DISTRO_NAME = "ISEE-Systemd"
DISTRO_FEATURES += " systemd"

DISTRO_FEATURES_remove = "x11 wayland"
DISTRO_FEAUTRES_append = " pulseaudio"
```

## conf/distro/isee-systemd.conf
```bitbake
require conf/distro/poky.conf
require common.inc

DISTRO = "isee-systemd"
DISTRO_NAME = "ISEE-Systemd"
DISTRO_FEATURES += " systemd"
```

## conf/distro/release.inc
```bitbake
#
# Distro tracking versions
#
ISEE_SUBVERSION = "3"
SDK_SUBVERSION = "${ISEE_SUBVERSION}"
EXTRAVERSION = ""
```

## conf/layer.conf
```bitbake
# We have a conf and classes directory, append to BBPATH
BBPATH .= ":${LAYERDIR}"

# We have a recipes directory, add to BBFILES
# We add another folder level
BBFILES += "${LAYERDIR}/recipes*/*/*/*.bb ${LAYERDIR}/recipes*/*/*/*.bbappend"
BBFILES += "${LAYERDIR}/recipes*/*/*.bb ${LAYERDIR}/recipes*/*/*.bbappend"

BBFILE_COLLECTIONS += "isee"
BBFILE_PATTERN_isee := "^${LAYERDIR}/"
BBFILE_PRIORITY_isee = "6"

# Add default directory for Freescale EULA files
FSL_EULA_FILE = "${LAYERDIR}/EULA"
```

## conf/machine/igep0020.conf
```bitbake
#@TYPE: Machine
#@NAME: IGEPv2 AM/DM37x
#@DESCRIPTION: Machine configuration for the IGEPv2 AM/DM37x Processor Board
#@MAINTAINER: Jose Miguel Sanchez Sanabria <jsanabria@iseebcn.com>

# Common options
require conf/machine/include/igep00x0.inc

# Debug Serial Console
SERIAL_CONSOLE = "115200 ttyO2"

# The Kernel target configuration.
KERNEL_DEVICETREE = "omap3-igep0020.dtb"

# The U-Boot target platform configuration.
UBOOT_MACHINE = "igep0020_defconfig"

# For a modularized kernel we want to drag in networking, sound, rtc etc."
MACHINE_EXTRA_RRECOMMENDS = "kernel-module-smsc0221 kernel-module-snd-soc-twl4030 \
kernel-module-rtc-twl kernel-module-snd-soc-omap"
```

## conf/machine/igep0020hf.conf
```bitbake
@TYPE: Machine
#@NAME: IGEPv2 AM/DM37x
#@DESCRIPTION: Machine configuration for the IGEPv2 AM/DM37x Processor Board
#@MAINTAINER: Jose Miguel Sanchez Sanabria <jsanabria@iseebcn.com>

# Default tune hard float
DEFAULTTUNE ?= "cortexa8hf-neon"

# Common options
require conf/machine/include/igep00x0.inc

# The Kernel target configuration.
KERNEL_DEVICETREE = "omap3-igep0020.dtb"

# The U-Boot target platform configuration.
UBOOT_MACHINE = "igep0020_defconfig"
```

## conf/machine/igep0030.conf
```bitbake
#@TYPE: Machine
#@NAME: ELECTRON COM MODULE AM/DM37x
#@DESCRIPTION: Machine configuration for the ELECTRON COM MODULE AM/DM37x Processor Board
#@MAINTAINER: Jose Miguel Sanchez Sanabria <jsanabria@iseebcn.com>

# Default tune hard float
DEFAULTTUNE ?= "cortexa8hf-neon"

# Common options
require conf/machine/include/igep00x0.inc

MACHINEOVERRIDES =. "dm3730:"

# The Kernel target configuration.
KERNEL_DEVICETREE = "omap3-igep0030.dtb"

# The U-Boot target platform configuration.
UBOOT_MACHINE = "igep0030_defconfig"

# Ship Firmware specific for this module
MACHINE_ESSENTIAL_EXTRA_RRECOMMENDS += " firmware-wifi"
```

## conf/machine/igep0033.conf
```bitbake
#@TYPE: Machine
#@NAME: IGEP COM AQUILA AM335x
#@DESCRIPTION: Machine configuration for the IGEP COM AQUILA AM335x Processor Board
#@MAINTAINER: Jose Miguel Sanchez Sanabria <jsanabria@iseebcn.com>

# Default tune hard float
DEFAULTTUNE ?= "cortexa8hf-neon"

# Common options
require conf/machine/include/igep00x0.inc

MACHINEOVERRIDES =. "ti33x:"

# Debug Serial Console
SERIAL_CONSOLE = "115200 ttyO0"

# The Kernel target configuration.
KERNEL_DEVICETREE = "am335x-base0033.dtb"

# The U-Boot target platform configuration.
UBOOT_MACHINE = "am335x_igep0033_defconfig"

# Ship Firmware specific for this module
MACHINE_ESSENTIAL_EXTRA_RRECOMMENDS += " firmware-wifi"
```

## conf/machine/igep0034.conf
```bitbake
#@TYPE: Machine
#@NAME: ISEE IGEP SMARC AM335x
#@DESCRIPTION: Machine configuration for the IGEP SMARC AM335x Processor Board
#@MAINTAINER: Jose Miguel Sanchez Sanabria <jsanabria@iseebcn.com>

# Default tune hard float
DEFAULTTUNE ?= "cortexa8hf-neon"

MACHINEOVERRIDES =. "ti33x:"

# Common options
require conf/machine/include/igep00x0.inc

# Debug Serial Console
SERIAL_CONSOLE = "115200 ttyO0"

# The U-Boot target platform configuration.
UBOOT_MACHINE = "am335x_igep0034_defconfig"

# The Kernel target configuration
KERNEL_DEVICETREE_igep0034 += "am335x-igep-base0040.dtb am335x-igep-base0040-lite.dtb"

# Ship Firmware specific for this module
MACHINE_ESSENTIAL_EXTRA_RRECOMMENDS += " firmware-wifi"
```

## conf/machine/igep0046dl.conf
```bitbake
#@TYPE: Machine
#@NAME: igep0046dl
#@SOC: i.MX6DL
#@DESCRIPTION: Machine configuration for igep0046dl module based on i.MX6DL SoC
#@MAINTAINER: Jose Miguel Sanchez Sanabria <jsanabria@iseebcn.com>

MACHINEOVERRIDES =. "mx6:mx6dl:"

include conf/machine/include/igepimx.inc
include conf/machine/include/tune-cortexa9.inc

PREFERRED_VERSION_u-boot-igep-imx ?= "2017.03"
PREFERRED_VERSION_linux-igep-imx ?= "4.9.11"
PREFERRED_VERSION_firmware-imx  ?= "6.0"

UBOOT_MACHINE ?= "igep0046_imx6dl_2G_defconfig"
KERNEL_DEVICETREE += "imx6dl-igep-base0040rd102.dtb"
SERIAL_CONSOLE ?= "115200 ttymxc1"
```

## conf/machine/igep0046q.conf
```bitbake
#@TYPE: Machine
#@NAME: igep0046
#@SOC: i.MX6Q
#@DESCRIPTION: Machine configuration for igep0046 module based on i.MX6Q SoC
#@MAINTAINER: Jose Miguel Sanchez Sanabria <jsanabria@iseebcn.com>

MACHINEOVERRIDES =. "mx6:mx6q:"

include conf/machine/include/igepimx.inc
include conf/machine/include/tune-cortexa9.inc

PREFERRED_VERSION_u-boot-igep-imx ?= "2017.03"
PREFERRED_VERSION_linux-igep-imx ?= "4.9.11"
PREFERRED_VERSION_firmware-imx  ?= "6.0"

UBOOT_MACHINE ?= "igep0046_imx6q_2G_defconfig"
KERNEL_DEVICETREE += "imx6q-igep-base0040rd102.dtb"
SERIAL_CONSOLE ?= "115200 ttymxc1"
```

## conf/machine/igep0146.conf
```bitbake
#@TYPE: Machine
#@NAME: igep0146
#@SOC: i.MX6UL
#@DESCRIPTION: Machine configuration for igep0146 module based on i.MX6UL SoC
#@MAINTAINER: Jose Miguel Sanchez Sanabria <jsanabria@iseebcn.com>

MACHINEOVERRIDES =. "mx6:mx6ul:"

include conf/machine/include/igepimx.inc
include conf/machine/include/tune-cortexa7.inc

PREFERRED_VERSION_u-boot-igep-imx ?= "2017.03"
PREFERRED_VERSION_linux-igep-imx ?= "4.9.11"
PREFERRED_VERSION_firmware-imx  ?= "6.0"

UBOOT_MACHINE ?= "igep0146_imx6ul_512M_defconfig"
KERNEL_DEVICETREE += "imx6dl-igep-base0040rd102.dtb"
SERIAL_CONSOLE ?= "115200 ttymxc2"

# Ship Firmware specific for this module
MACHINE_ESSENTIAL_EXTRA_RRECOMMENDS += " firmware-wifi"
```

## conf/machine/include/igep-common.inc
```bitbake
# Common configuration for all igep machines

# Add U-boot to building stage
EXTRA_IMAGEDEPENDS_sopa0000 += "u-boot-igep-sopa"
EXTRA_IMAGEDEPENDS_igep0020 += "u-boot-igep"
EXTRA_IMAGEDEPENDS_igep0020hf += "u-boot-igep"
EXTRA_IMAGEDEPENDS_igep0030 += "u-boot-igep"
EXTRA_IMAGEDEPENDS_igep0032 += "u-boot-igep"
EXTRA_IMAGEDEPENDS_igep0033 += "u-boot-igep"
EXTRA_IMAGEDEPENDS_igep0034 += "u-boot-igep"
EXTRA_IMAGEDEPENDS_igep0046dl += "u-boot-igep-imx"
EXTRA_IMAGEDEPENDS_igep0046q += "u-boot-igep-imx"
EXTRA_IMAGEDEPENDS_igep0146 += "u-boot-igep-imx"

GCCVERSION = "6.3%"
PREFERRED_VERSION_linux-libc-headers ?= "4.10"
PREFERRED_VERSION_linux-yocto ?= "3.2%"
KERNEL_IMAGETYPE = "zImage"
IMAGE_FSTYPES += "tar.bz2"

# Don't include kernels in standard images
RDEPENDS_kernel-base = ""
```

## conf/machine/include/igep00x0.inc
```bitbake
#@TYPE: Common Machine
#@NAME: IGEP common machine
#@DESCRIPTION: Common machine configuration for the IGEP OMAP3 boards
#@MAINTAINER: Jose Miguel Sanchez Sanabria <jsanabria@iseebcn.com>

# Common options
require conf/machine/include/igep-common.inc

PREFERRED_PROVIDER_virtual/xserver ?= "xserver-xorg-lite"
XSERVER ?= "xserver-xorg-lite \
           xf86-input-evdev \
           xf86-input-mouse \
           xf86-video-omapfb \
           xf86-input-keyboard"

# Ship all kernel modules by default
MACHINE_EXTRA_RRECOMMENDS = " kernel-modules linux-firmware-sd8686"

# U-Boot building for arch
UBOOT_ARCH = "arm"
UBOOT_ENTRYPOINT = "0x80008000"
UBOOT_LOADADDRESS = "0x80008000"
UBOOT_SUFFIX ?= "img"
SPL_BINARY ?= "MLO"

include conf/machine/include/tune-cortexa8.inc

# 2.6.37 and later kernels use OMAP_SERIAL, ttyO2 earlier kernels use ttyS2
SERIAL_CONSOLE ?= "115200 ttyO2"

PREFERRED_PROVIDER_virtual/bootloader ?= "u-boot-igep"
PREFERRED_VERSION_u-boot-igep ?= "2017.03"
PREFERRED_PROVIDER_virtual/kernel ?= "linux-igep"
PREFERRED_VERSION_linux-igep ?= "4.9.81"

MACHINE_FEATURES = "kernel26 usbgadget usbhost vfat alsa wifi bluetooth touchscreen"
```
